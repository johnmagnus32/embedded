## Kconfig
```kconfig
mainmenu "simple-stm32 RTOS Configuration"

source "src/arch/arm/Kconfig"
source "src/kernel/Kconfig"
source "src/lib/Kconfig"
source "src/fs/Kconfig"
source "src/drivers/Kconfig"
```

## os/Kconfig
```kconfig
mainmenu "simple-stm32 RTOS Configuration"

source "os/arch/arm/Kconfig"
source "os/kernel/Kconfig"
source "os/lib/Kconfig"
source "os/fs/Kconfig"
source "os/net/Kconfig"
source "os/drivers/Kconfig"
```

## os/arch/arm/Kconfig
```kconfig
menu "Architecture"

config CPU_CORTEX_M4
    bool "ARM Cortex-M4"
    default y

config CPU_CORTEX_M0PLUS
    bool "ARM Cortex-M0+"
    default n

config SYSTICK
    bool "SysTick timer"
    default y

config SMP
    bool "Symmetric multiprocessing"
    default n
    depends on CPU_CORTEX_M0PLUS

config SMP_NUM_CPUS
    int "Number of CPUs"
    default 1

endmenu
```

## os/drivers/Kconfig
```kconfig
menu "Drivers"

config CLOCK
    bool "Clock control"
    default y

config CLOCK_RP2040
    bool "RP2040 resets driver"
    default n
    depends on CLOCK

config UART
    bool "UART serial driver"
    default y
    depends on CLOCK

config UART_PL011
    bool "ARM PL011 UART (RP2040)"
    default n
    depends on UART

config GPIO
    bool "GPIO driver"
    default y

config GPIO_RP2040
    bool "RP2040 GPIO driver"
    default n
    depends on GPIO

config SPI
    bool "SPI bus driver"
    default y
    depends on CLOCK

config FLASH
    bool "W25Q NOR flash driver"
    default y
    depends on SPI

config GPIO_KEYS
    bool "GPIO keys (button input)"
    default y
    depends on GPIO

config GPIO_LEDS
    bool "GPIO LEDs (LED output)"
    default y
    depends on GPIO

endmenu
```

## os/fs/Kconfig
```kconfig
menu "Filesystems"

config FS
    bool "Virtual filesystem layer"
    default y
    depends on FLASH
    help
      VFS dispatch layer for filesystem operations.

config TINYFS
    bool "TinyFS filesystem"
    default y
    depends on FS
    help
      Simple flat filesystem. 15 files, 4KB each, on NOR flash.

endmenu
```

## os/kernel/Kconfig
```kconfig
menu "Kernel"

config SCHED
    bool "Scheduler"
    default y

config SYNC
    bool "Synchronization primitives"
    default y
    depends on SCHED

config MSGQ
    bool "Message queues"
    default y
    depends on SCHED

config USERSPACE
    bool "User/kernel separation (syscalls)"
    default n
    depends on SCHED

config ELFLOADER
    bool "ELF program loader"
    default n
    depends on SCHED && HEAP
    help
      Load and execute ELF binaries from the filesystem.

endmenu
```

## os/lib/Kconfig
```kconfig
menu "Libraries"

config HEAP
    bool "Heap allocator"
    default y
    help
      First-fit heap with coalescing (malloc/free).

config MEMSLAB
    bool "Memory slab allocator"
    default y
    help
      Fixed-size block allocator. O(1) alloc and free.

config LOG
    bool "Deferred logging"
    default y
    depends on SCHED
    help
      Ring buffer logging with background UART output.

config SHELL
    bool "Interactive shell"
    default y
    depends on UART && SCHED
    help
      UART command shell for debugging and inspection.

endmenu
```

## rtos/arch/arm/Kconfig
```kconfig
menu "Architecture"

config CPU_CORTEX_M4
    bool "ARM Cortex-M4"
    default y

config CPU_CORTEX_M0PLUS
    bool "ARM Cortex-M0+"
    default n

config SYSTICK
    bool "SysTick timer"
    default y

config MPU
    bool "MPU stack protection"
    default n
    depends on CPU_CORTEX_M4
    help
      Use the Memory Protection Unit to isolate task stacks.
      A task writing outside its stack triggers a MemManage fault.

config SMP
    bool "Symmetric multiprocessing"
    default n
    depends on CPU_CORTEX_M0PLUS

config SMP_NUM_CPUS
    int "Number of CPUs"
    default 1

endmenu
```

## rtos/kernel/Kconfig
```kconfig
menu "Kernel"

config SCHED
    bool "Scheduler"
    default y

config SYNC
    bool "Synchronization primitives"
    default y
    depends on SCHED

config MSGQ
    bool "Message queues"
    default y
    depends on SCHED

config USERSPACE
    bool "User/kernel separation (syscalls)"
    default n
    depends on SCHED

config ELFLOADER
    bool "ELF program loader"
    default n
    depends on SCHED && HEAP

config PM
    bool "Per-device power management"
    default n

endmenu
```

## rtos/net/Kconfig
```kconfig
menu "Networking"

# NET config is in drivers/Kconfig (depends on driver availability)

endmenu
```

## src/drivers/Kconfig
```kconfig
menu "Drivers"

config CLOCK
    bool "Clock control (RCC)"
    default y
    help
      STM32 RCC clock driver. Required by all other drivers.

config UART
    bool "UART serial driver"
    default y
    depends on CLOCK
    help
      STM32 USART driver for console output.

config GPIO
    bool "GPIO driver"
    default y
    depends on CLOCK
    help
      STM32 GPIO input/output driver.

config SPI
    bool "SPI bus driver"
    default y
    depends on CLOCK
    help
      STM32 SPI master driver.

config FLASH
    bool "W25Q128 NOR flash driver"
    default y
    depends on SPI
    help
      SPI NOR flash driver for Winbond W25Q128.

config GPIO_KEYS
    bool "GPIO keys (button input)"
    default y
    depends on GPIO
    help
      Button driver using gpio-keys device tree binding.

config GPIO_LEDS
    bool "GPIO LEDs (LED output)"
    default y
    depends on GPIO
    help
      LED driver using gpio-leds device tree binding.

endmenu
```

## src/lib/Kconfig
```kconfig
menu "Libraries"

config HEAP
    bool "Heap allocator"
    default y
    help
      First-fit heap with coalescing (malloc/free).

config MEMSLAB
    bool "Memory slab allocator"
    default y
    help
      Fixed-size block allocator. O(1) alloc and free.

config LOG
    bool "Deferred logging"
    default y
    depends on SCHED
    help
      Ring buffer logging with background UART output.

endmenu
```
